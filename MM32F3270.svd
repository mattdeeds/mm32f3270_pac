# MM32F3270 register map
File version: 3.01
CPU: CM3 r2p1, selectable endian, MPU, no FPU, 3 interrupt priority bits
Registers are 32-bit, read-write, reset 0x0 unless marked. A register's access mark holds for its fields unless they carry their own. Offsets are from the block's base; lines under a group give offsets from that group; [hi:lo] are bit positions; {n}, {i} and the like mark numbered series; 'fields as' and 'values as' point back to an identical list; <NAME> marks a mode.

## Memory map
0x1FFFF7E8 DEVICE size 0x400
0x40000000 TIM2 size 0x400 — General purpose timer
0x40000400 TIM3 size 0x400 — General purpose timer
0x40000800 TIM4 size 0x400
0x40000C00 TIM5 size 0x400
0x40001000 TIM6 size 0x400 — Basic purpose timer
0x40001400 TIM7 size 0x400
0x40002800 RTC size 0x30 — Real time clock
0x40002840 BKP size 0x2E0 — Backup registers
0x40002C00 WWDG size 0x60 — Window watchdog
0x40003000 IWDG size 0x400 — Independent watchdog
0x40003800 SPI2 size 0x400
0x40003C00 SPI3 size 0x400
0x40004400 UART2 size 0x400
0x40004800 UART3 size 0x400
0x40004C00 UART4 size 0x400
0x40005000 UART5 size 0x400
0x40005400 I2C1 size 0x400 — Inter integrated circuit
0x40005800 I2C2 size 0x400
0x40006400 CAN size 0x400 — Controller area network
0x40006C00 CRS size 0x400 — CRS registers
0x40007000 PWR size 0x8 — Power control
0x40007080 DBG size 0x40 — Debug support
0x40007400 DAC size 0x400 — Digital to analog converter
0x40007800 UART7 size 0x400
0x40007C00 UART8 size 0x400
0x40010000 SYSCFG size 0x400
0x40010400 EXTI size 0x400 — External interrupt/event controller
0x40012400 ADC1 size 0x400 — Analog to digital converter 1
0x40012800 ADC2 size 0x400 — Analog to digital converter 2
0x40012C00 TIM1 size 0x400 — Advanced timer
0x40013000 SPI1 size 0x400 — Serial peripheral interface
0x40013400 TIM8 size 0x400
0x40013800 UART1 size 0x400 — Universal asynchronous receiver transmitter
0x40013C00 UART6 size 0x400
0x40014000 COMP size 0x400 — Comparator
0x40014C00 ADC3 size 0x400 — Analog to digital converter 3
0x40016000 CACHE size 0x400
0x40018000 SDIO size 0x400
0x40020000 DMA1 size 0x400 — DMA1 controller
0x40020400 DMA2 size 0x400 — DMA2 controller
0x40021000 RCC size 0x400 — Reset and clock control
0x40022000 FLASH size 0x400
0x40023000 CRC size 0x400 — CRC calculation unit
0x40028000 Ethernet_MAC size 0x1000 — Ethernet: media access control (MAC)
0x40029000 Ethernet_DMA size 0x400 — Ethernet: DMA controller operation
0x40040000 GPIOA size 0x400 — General purpose I/O
0x40040400 GPIOB size 0x400 — General purpose I/O
0x40040800 GPIOC size 0x400 — General purpose I/O
0x40040C00 GPIOD size 0x400 — General purpose I/O
0x40041000 GPIOE size 0x400 — General purpose I/O
0x40041400 GPIOF size 0x400 — General purpose I/O
0x40041800 GPIOG size 0x400 — General purpose I/O
0x40041C00 GPIOH size 0x400 — General purpose I/O
0x50000000 OTG_FS size 0x40000 — USB On-The-Go Full-Speed

## Interrupts
0 WWDG — Window Watchdog interrupt
1 PVD (PWR) — PVD through EXTI line detection interrupt
2 TAMPER (EXTI) — Tamper interrupt
3 RTC — RTC global interrupt
4 FLASH — Flash global interrupt
5 RCC_CRS (CRS, RCC) — RCC and CRS global Interrupts
6 EXTI0 (EXTI) — EXTI Line0 interrupt
7 EXTI1 (EXTI) — EXTI Line1 interrupt
8 EXTI2 (EXTI) — EXTI Line2 interrupt
9 EXTI3 (EXTI) — EXTI Line3 interrupt
10 EXTI4 (EXTI) — EXTI Line4 interrupt
11 DMA1_Channel1 (DMA1) — DMA1 Channel1 global interrupt
12 DMA1_Channel2 (DMA1) — DMA1 Channel2 global interrupt
13 DMA1_Channel3 (DMA1) — DMA1 Channel3 global interrupt
14 DMA1_Channel4 (DMA1) — DMA1 Channel4 global interrupt
15 DMA1_Channel5 (DMA1) — DMA1 Channel5 global interrupt
16 DMA1_Channel6 (DMA1) — DMA1 Channel6 global interrupt
17 DMA1_Channel7 (DMA1) — DMA1 Channel7 global interrupt
18 ADC1_2 (ADC1, ADC2) — ADC1 and ADC2 global Interrupts
19 CACHE — CACHE global Interrupts
21 CAN1_RX (CAN) — CAN1 Receive Interrupt
23 EXTI9_5 (EXTI) — EXTI Line[9_5] interrupts
24 TIM1_BRK (TIM1) — TIM1 break interrupt
25 TIM1_UP (TIM1) — TIM1 update interrupt
26 TIM1_TRG_COM (TIM1) — TIM1 trigger and communicate interrupt
27 TIM1_CC (TIM1) — TIM1 Capture Compare interrupt
28 TIM2 — TIM2 global interrupt
29 TIM3 — TIM3 global interrupt
30 TIM4 — TIM4 global interrupt
31 I2C1 — I2C1 interrupt
33 I2C2 — I2C2 interrupt
35 SPI1 — SPI1 global interrupt
36 SPI2 — SPI2 global interrupt
37 UART1 — UART1 global interrupt
38 UART2 — UART2 global interrupt
39 UART3 — UART3 global interrupt
40 EXTI15_10 (EXTI) — EXTI Line[15_10] interrupts
41 RTCAlarm (RTC) — RTC Alarms through EXTI line interrupt
43 TIM8_BRK (TIM8) — TIM8 break interrupt
44 TIM8_UP (TIM8) — TIM8 update interrupt
45 TIM8_TRG_COM (TIM8) — TIM8 trigger and communicate interrupt
46 TIM8_CC (TIM8) — TIM8 Capture Compare interrupt
47 ADC3 — ADC3 global Interrupts
49 SDIO — SDIO global interrupt
50 TIM5 — TIM5 global interrupt
51 SPI3 — SPI3 global interrupt
52 UART4 — UART4 global interrupt
53 UART5 — UART5 global interrupt
54 TIM6 — TIM6 global interrupt
55 TIM7 — TIM7 global interrupt
56 DMA2_Channel1 (DMA2) — DMA2 Channel1 global interrupt
57 DMA2_Channel2 (DMA2) — DMA2 Channel2 global interrupt
58 DMA2_Channel3 (DMA2) — DMA2 Channel3 global interrupt
59 DMA2_Channel4 (DMA2) — DMA2 Channel4 global interrupt
60 DMA2_Channel5 (DMA2) — DMA2 Channel5 global interrupt
61 ETH (Ethernet_DMA) — Ethernet global interrupt
64 COMP_1_2 (COMP) — Comparator 1/2 Interrupts
71 UART6 — UART6 global interrupt
82 UART7 — UART7 global interrupt
83 UART8 — UART8 global interrupt
